#define dl A2 //прописываем подключения портов, чтоб не запоминать что куда подключено
#define dr A3
#define M1_DIR 4
#define M1_PWM 5
#define M2_DIR 7
#define M2_PWM 6


void InitMotors() //объявляем порты, отвечающие за управление двигателями
{
  pinMode(M1_DIR, OUTPUT); 
  pinMode(M1_PWM, OUTPUT);
  pinMode(M2_DIR, OUTPUT);
  pinMode(M2_PWM, OUTPUT);
}

void Motors(int Speed1, int Speed2)//подпрограмма управления двигателями
{
  if (Speed1 > 255) Speed1 = 255; //задаем ограничения по входным скоростям (ограничение ШИМ 255 = 100% скорость вращения двигателя)
  if (Speed1 < -255) Speed1 = -255;
  if (Speed2 > 255) Speed2 = 255;
  if (Speed2 < -255) Speed2 = -255;

  if (Speed1 > 0) //если входное значение больше 0, значит двигатель надо вращать вперед, соответсвтенно на дискретный порт подается 1 (вперед), на аналог значение скорости вращения.
  {
    digitalWrite(M1_DIR, 1);
    analogWrite(M1_PWM, Speed1);
  }
  else //если входное значение меньше 0, значит двигатель надо вращать назад, соответсвтенно на дискретный порт подается 0 (назад), на аналог значение скорости вращения по модулю.
  {
    digitalWrite(M1_DIR, 0);
    analogWrite(M1_PWM, -Speed1);
  }

  if (Speed2 > 0) //аналогичное управление для второго мотора
  {
    digitalWrite(M2_DIR, 1);
    analogWrite(M2_PWM, Speed2);
  }
  else
  {
    digitalWrite(M2_DIR, 0);
    analogWrite(M2_PWM, -Speed2);
  }
}


void setup()
{
  Serial.begin(9600); //объявляем скорость работы сериал порта
  pinMode(12, INPUT_PULLUP);//объявим порт кнопки с pullup для устранения возможного дребезга
  InitMotors(); //запускаем подпрограмму, объявляющую порты двигателя
}

int k = 0; //вводим переменную состояния (значение 0 - тележка ждет нажатия кнопки, значение 1 - тележка начинает движение по линии)
int avgspeed = 200; //вводим переменную, отвечающую за среднее значение скорости движения тележки (скорость движения, если оба датчика стоят на белом)
int kP = 4; //вводим переменную, коэффициента P-регулятора


void loop() {
  int DLc = analogRead(dl); //считываем показания левого датчика в переменную
  int DRc = analogRead(dr); //считываем показания правого датчика в переменную
  int DL = map (DLc, 357, 862, 100, 0); //преобразуем значения с левого датчика в диапазон от 0 до 100 (0-черный, 100-белый), значения 357 и 862 соответсвуют показаниям левого датчика на черном и белом соответственно
  int DR = map (DRc, 541, 912, 100, 0); //преобразуем значения с правого датчика в диапазон от 0 до 100 (0-черный, 100-белый), значения 541 и 912 соответсвуют показаниям левого датчика на черном и белом соответственно
  int button = digitalRead(12); //считываем показания с кнопки
  Serial.println(String(k) + ' ' + String(button) + ' ' + String(DLc) + ' ' + String(DRc)); //выводим на экран показания кнопки, переменной состояния, показания левого датчика и правого датчика (для калибровки датчиков и проверки работоспособности кнопки)
  if (button == 0) //меняем переменную состояния, если кнопка была нажата
  {
    k = 1;
  }
  if (k == 1) { //проверка состояния и начало движения
    int correctionL = DL * kP; //переменная корректировки по левому датчику
    int correctionR = DR * kP; //переменная корректировки по правому датчику
    Motors(avgspeed - correctionL + correctionR, avgspeed - correctionR + correctionL); //запуск моторов с учетом корректировок
  }
}
